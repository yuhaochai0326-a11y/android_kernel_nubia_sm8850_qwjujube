// SPDX-License-Identifier: BSD-3-Clause
/*
 * Copyright (c) 2023-2024 Qualcomm Innovation Center, Inc. All rights reserved.
 */

&mdss_mdp {
	dsi_bf375_rm692h5_6p8_dev0_dsc_cmd: qcom,mdss_dsi_bf375_rm692h5_6p8_dev0_dsc_cmd {
		qcom,mdss-dsi-panel-name =
				"BF375_RM692H5_6P8_DEV0_DSC_CMD";
		#include "dsi-panel-zte-bf375-rm692h5-common.dtsi"
	};
};

